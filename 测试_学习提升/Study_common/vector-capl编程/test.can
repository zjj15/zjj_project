/*@@var:*/
variables
{
    message     NAV_MSC_FrI00  pc_rx_data;
    message     DIAG_MSC_FrI00 pc_tx_func;
    message     DIAG_MSC_FrI02 pc_tx_phys;
	byte		Long_Txdata[4096];
	byte		Long_Rxdata[4096];

}
/*@@end*/

/*@@mainTest:MainTest():*/
void MainTest()
{
    TestModuleTitle ("CAN Diag Tester");
    TestModuleDescription ("a funny test of can diagnostic");
    TestGroupBegin("CAN TEST", "send and receive a message");
    SndAndRev ();
    TestGroupEnd(); 
}
/*@@end*/

/*@@testcase:SndAndRev():*/
testcase SndAndRev ()
{
    long rev_flag = 0;
    pc_tx_phys.DiagnosticReqNAV_b0 = 0x02;
    pc_tx_phys.DiagnosticReqNAV_b1 = 0x10;
    pc_tx_phys.DiagnosticReqNAV_b2 = 0x03;


    
    TestCaseTitle("CAN TEST", "Send and Receive");
    TestCaseDescription("send a request and receive a response,then check the response");
    TestStep ("Test Step", "send a request first");
    output(pc_tx_phys);
    rev_flag = TestWaitForMessage(NAV_MSC_FrI00,500);
    if(rev_flag == 1)
    {
        TestStepPass("Test Step", "got it!!!!!"); 
    }
    else if(rev_flag == 0)
    {
        TestStepFail("Test Step", "no receive"); 
    }
    else 
    {
        TestStepFail("Test Step", "Error!!!!"); 
    }
    TestStep ("Test Step", "check the response");
    if((pc_rx_data.DiagnosticRespNAV_b0 == 0x06)&&(pc_rx_data.DiagnosticRespNAV_b1 == 0x50)&&(pc_rx_data.DiagnosticRespNAV_b2 == 0x03)&&(pc_rx_data.DiagnosticRespNAV_b3 == 0x00)&&(pc_rx_data.DiagnosticRespNAV_b4 == 0x64)&&(pc_rx_data.DiagnosticRespNAV_b5 == 0x00)&&(pc_rx_data.DiagnosticRespNAV_b6 == 0x64))
     {
       TestStepPass("Test Step", "the response is right!!!!"); 
     }
     else
     {
         TestStepFail("Test Step", "the response is wrong !!!"); 
     }
}
/*@@end*/

/*@@msg:CAN1._______lh1IP21MCE_NAV_EP1V11::NAV_MSC_FrI00 (0x769):*/
on message NAV_MSC_FrI00
{
     pc_rx_data = this;
    
}
/*@@end*/

