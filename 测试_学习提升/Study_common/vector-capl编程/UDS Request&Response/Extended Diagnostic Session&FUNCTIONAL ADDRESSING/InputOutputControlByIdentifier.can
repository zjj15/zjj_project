variables
{
    message     NAV_MSC_FrI00  pc_rx_data;
    message     DIAG_MSC_FrI00 pc_tx_func;
    message     DIAG_MSC_FrI02 pc_tx_phys;
	byte		Long_Txdata[4096];
	byte		Long_Rxdata[4096];
    const long P2max = 40;
    const long P2smax = 40;
}

void MainTest()
{
    TestModuleTitle ("UDS on CAN Request&Response Test");
    TestModuleDescription (" Default Diagnostic Session, Physical Addressing.SID=InputOutputControlByIdentifier");
    TestGroupBegin("CAN Diagnostic Message Test", "Test the InputOutputControlByIdentifier service");
    InputOutputControlByIdentifier_Test();
    TestGroupEnd(); 
}

on message NAV_MSC_FrI00
{
     pc_rx_data = this;
}

testcase InputOutputControlByIdentifier_Test ()
{
    long rev_flag = 0;
   
   TestCaseTitle("CommunicationControl_Test TEST", "Request and check the response");
    TestCaseDescription("send a request and receive a response,then check the response");
    TestStep ("Test Step", "Send:2F E0 01 00");
    pc_tx_func.DiagnosticFuncAddrRq_m_b0 = 0x04;
    pc_tx_func.DiagnosticFuncAddrRq_m_b1 = 0x2F;
    pc_tx_func.DiagnosticFuncAddrRq_m_b2 = 0xE0;
    pc_tx_func.DiagnosticFuncAddrRq_m_b3 = 0x01;    
    pc_tx_func.DiagnosticFuncAddrRq_m_b4 = 0x00;
    output(pc_tx_func);
    rev_flag = TestWaitForMessage(NAV_MSC_FrI00,P2max);
    if(rev_flag == 1)
    {
        TestStepPass("Test Step","There is a response in time");
    }
    else if(rev_flag == 0)
    {
        TestStepFail("Test Step","Wrong!No response");
    }
    else 
    {
        TestStepFail("Test Step", "Error!"); 
    }
    TestStep ("Test Step", "Check the response");
    if((pc_rx_data.DiagnosticRespNAV_b0 == 0x03)&&(pc_rx_data.DiagnosticRespNAV_b1 == 0x7F)&&(pc_rx_data.DiagnosticRespNAV_b2 == 0x2F)&&(pc_rx_data.DiagnosticRespNAV_b3 == 0x7F))
    {
         TestStepPass("Test Step","Response Correct");
    }
    else
    {
        TestStepFail("Test Step","Response Wrong");
    }
    TestWaitForTimeout(100);
	
	
    TestCaseTitle("CommunicationControl_Test TEST", "Request and check the response");
    TestCaseDescription("send a request and receive a response,then check the response");
    TestStep ("Test Step", "Send:2F E0 01 02");
    pc_tx_func.DiagnosticFuncAddrRq_m_b0 = 0x04;
    pc_tx_func.DiagnosticFuncAddrRq_m_b1 = 0x2F;
    pc_tx_func.DiagnosticFuncAddrRq_m_b2 = 0xE0;
    pc_tx_func.DiagnosticFuncAddrRq_m_b3 = 0x01;    
    pc_tx_func.DiagnosticFuncAddrRq_m_b4 = 0x02;
    output(pc_tx_func);
    rev_flag = TestWaitForMessage(NAV_MSC_FrI00,P2max);
    if(rev_flag == 1)
    {
        TestStepPass("Test Step","There is a response in time");
    }
    else if(rev_flag == 0)
    {
        TestStepFail("Test Step","Wrong!No response");
    }
    else 
    {
        TestStepFail("Test Step", "Error!"); 
    }
    TestStep ("Test Step", "Check the response");
    if((pc_rx_data.DiagnosticRespNAV_b0 == 0x03)&&(pc_rx_data.DiagnosticRespNAV_b1 == 0x7F)&&(pc_rx_data.DiagnosticRespNAV_b2 == 0x2F)&&(pc_rx_data.DiagnosticRespNAV_b3 == 0x7F))
    {
         TestStepPass("Test Step","Response Correct");
    }
    else
    {
        TestStepFail("Test Step","Response Wrong");
    }
    TestWaitForTimeout(100);
	
	pc_tx_func.DiagnosticFuncAddrRq_m_b0 = 0x05;
    pc_tx_func.DiagnosticFuncAddrRq_m_b1 = 0x2F;
    pc_tx_func.DiagnosticFuncAddrRq_m_b2 = 0xE0;
    pc_tx_func.DiagnosticFuncAddrRq_m_b3 = 0x01;
    pc_tx_func.DiagnosticFuncAddrRq_m_b4 = 0x03;
    pc_tx_func.DiagnosticFuncAddrRq_m_b5 = 0x00;
    TestStep ("Test Step", "Send:2F E0 01 03 00");
    output(pc_tx_func);
    rev_flag = TestWaitForMessage(NAV_MSC_FrI00,P2max);
    if(rev_flag == 1)
    {
        TestStepPass("Test Step","There is a response in time");
    }
    else if(rev_flag == 0)
    {
        TestStepFail("Test Step","Wrong!No response");
    }
    else 
    {
        TestStepFail("Test Step", "Error!"); 
    }
    TestStep ("Test Step", "Check the response");
    if((pc_rx_data.DiagnosticRespNAV_b0 == 0x03)&&(pc_rx_data.DiagnosticRespNAV_b1 == 0x7F)&&(pc_rx_data.DiagnosticRespNAV_b2 == 0x2F)&&(pc_rx_data.DiagnosticRespNAV_b3 == 0x7F))
    {
         TestStepPass("Test Step","Response Correct");
    }
    else
    {
        TestStepFail("Test Step","Response Wrong");
    }
    TestWaitForTimeout(100);
	
	
    pc_tx_func.DiagnosticFuncAddrRq_m_b0 = 0x05;
    pc_tx_func.DiagnosticFuncAddrRq_m_b1 = 0x2F;
    pc_tx_func.DiagnosticFuncAddrRq_m_b2 = 0xE0;
    pc_tx_func.DiagnosticFuncAddrRq_m_b3 = 0x01;
    pc_tx_func.DiagnosticFuncAddrRq_m_b4 = 0x03;
    pc_tx_func.DiagnosticFuncAddrRq_m_b5 = 0x01;
    TestStep ("Test Step", "Send:2F E0 01 03 01");
    output(pc_tx_func);
    rev_flag = TestWaitForMessage(NAV_MSC_FrI00,P2max);
    if(rev_flag == 1)
    {
        TestStepPass("Test Step","There is a response in time");
    }
    else if(rev_flag == 0)
    {
        TestStepFail("Test Step","Wrong!No response");
    }
    else 
    {
        TestStepFail("Test Step", "Error!"); 
    }
    TestStep ("Test Step", "Check the response");
    if((pc_rx_data.DiagnosticRespNAV_b0 == 0x03)&&(pc_rx_data.DiagnosticRespNAV_b1 == 0x7F)&&(pc_rx_data.DiagnosticRespNAV_b2 == 0x2F)&&(pc_rx_data.DiagnosticRespNAV_b3 == 0x7F))
    {
         TestStepPass("Test Step","Response Correct");
    }
    else
    {
        TestStepFail("Test Step","Response Wrong");
    }
    TestWaitForTimeout(100);
	
	
	pc_tx_func.DiagnosticFuncAddrRq_m_b0 = 0x05;
    pc_tx_func.DiagnosticFuncAddrRq_m_b1 = 0x2F;
    pc_tx_func.DiagnosticFuncAddrRq_m_b2 = 0xE0;
    pc_tx_func.DiagnosticFuncAddrRq_m_b3 = 0x01;
    pc_tx_func.DiagnosticFuncAddrRq_m_b4 = 0x03;
    pc_tx_func.DiagnosticFuncAddrRq_m_b5 = 0x02;
    TestStep ("Test Step", "Send:2F E0 01 03 02");
    output(pc_tx_func);
    rev_flag = TestWaitForMessage(NAV_MSC_FrI00,P2max);
    if(rev_flag == 1)
    {
        TestStepPass("Test Step","There is a response in time");
    }
    else if(rev_flag == 0)
    {
        TestStepFail("Test Step","Wrong!No response");
    }
    else 
    {
        TestStepFail("Test Step", "Error!"); 
    }
    TestStep ("Test Step", "Check the response");
    if((pc_rx_data.DiagnosticRespNAV_b0 == 0x03)&&(pc_rx_data.DiagnosticRespNAV_b1 == 0x7F)&&(pc_rx_data.DiagnosticRespNAV_b2 == 0x2F)&&(pc_rx_data.DiagnosticRespNAV_b3 == 0x7F))
    {
         TestStepPass("Test Step","Response Correct");
    }
    else
    {
        TestStepFail("Test Step","Response Wrong");
    }
    TestWaitForTimeout(100);
	
	
	pc_tx_func.DiagnosticFuncAddrRq_m_b0 = 0x04;
    pc_tx_func.DiagnosticFuncAddrRq_m_b1 = 0x2F;
    pc_tx_func.DiagnosticFuncAddrRq_m_b2 = 0xE0;
    pc_tx_func.DiagnosticFuncAddrRq_m_b3 = 0x02;    
    pc_tx_func.DiagnosticFuncAddrRq_m_b4 = 0x00;
    TestStep ("Test Step", "Send:2F E0 02 00");
    output(pc_tx_func);
    rev_flag = TestWaitForMessage(NAV_MSC_FrI00,P2max);
    if(rev_flag == 1)
    {
        TestStepPass("Test Step","There is a response in time");
    }
    else if(rev_flag == 0)
    {
        TestStepFail("Test Step","Wrong!No response");
    }
    else 
    {
        TestStepFail("Test Step", "Error!"); 
    }
    TestStep ("Test Step", "Check the response");
    if((pc_rx_data.DiagnosticRespNAV_b0 == 0x03)&&(pc_rx_data.DiagnosticRespNAV_b1 == 0x7F)&&(pc_rx_data.DiagnosticRespNAV_b2 == 0x2F)&&(pc_rx_data.DiagnosticRespNAV_b3 == 0x7F))
    {
         TestStepPass("Test Step","Response Correct");
    }
    else
    {
        TestStepFail("Test Step","Response Wrong");
    }
	
	
	pc_tx_func.DiagnosticFuncAddrRq_m_b0 = 0x04;
    pc_tx_func.DiagnosticFuncAddrRq_m_b1 = 0x2F;
    pc_tx_func.DiagnosticFuncAddrRq_m_b2 = 0xE0;
    pc_tx_func.DiagnosticFuncAddrRq_m_b3 = 0x02;    
    pc_tx_func.DiagnosticFuncAddrRq_m_b4 = 0x02;
    TestStep ("Test Step", "Send:2F E0 02 02");
    output(pc_tx_func);
    rev_flag = TestWaitForMessage(NAV_MSC_FrI00,P2max);
    if(rev_flag == 1)
    {
        TestStepPass("Test Step","There is a response in time");
    }
    else if(rev_flag == 0)
    {
        TestStepFail("Test Step","Wrong!No response");
    }
    else 
    {
        TestStepFail("Test Step", "Error!"); 
    }
    TestStep ("Test Step", "Check the response");
    if((pc_rx_data.DiagnosticRespNAV_b0 == 0x03)&&(pc_rx_data.DiagnosticRespNAV_b1 == 0x7F)&&(pc_rx_data.DiagnosticRespNAV_b2 == 0x2F)&&(pc_rx_data.DiagnosticRespNAV_b3 == 0x7F))
    {
         TestStepPass("Test Step","Response Correct");
    }
    else
    {
        TestStepFail("Test Step","Response Wrong");
    }
	
	
	pc_tx_func.DiagnosticFuncAddrRq_m_b0 = 0x05;
    pc_tx_func.DiagnosticFuncAddrRq_m_b1 = 0x2F;
    pc_tx_func.DiagnosticFuncAddrRq_m_b2 = 0xE0;
    pc_tx_func.DiagnosticFuncAddrRq_m_b3 = 0x02;    
    pc_tx_func.DiagnosticFuncAddrRq_m_b4 = 0x03;
	pc_tx_func.DiagnosticFuncAddrRq_m_b5 = 0x55;
    TestStep ("Test Step", "Send:2F E0 02 03 55");
    output(pc_tx_func);
    rev_flag = TestWaitForMessage(NAV_MSC_FrI00,P2max);
    if(rev_flag == 1)
    {
        TestStepPass("Test Step","There is a response in time");
    }
    else if(rev_flag == 0)
    {
        TestStepFail("Test Step","Wrong!No response");
    }
    else 
    {
        TestStepFail("Test Step", "Error!"); 
    }
    TestStep ("Test Step", "Check the response");
    if((pc_rx_data.DiagnosticRespNAV_b0 == 0x03)&&(pc_rx_data.DiagnosticRespNAV_b1 == 0x7F)&&(pc_rx_data.DiagnosticRespNAV_b2 == 0x2F)&&(pc_rx_data.DiagnosticRespNAV_b3 == 0x7F))
    {
         TestStepPass("Test Step","Response Correct");
    }
    else
    {
        TestStepFail("Test Step","Response Wrong");
    }
	
	
	pc_tx_func.DiagnosticFuncAddrRq_m_b0 = 0x04;
    pc_tx_func.DiagnosticFuncAddrRq_m_b1 = 0x2F;
    pc_tx_func.DiagnosticFuncAddrRq_m_b2 = 0xE0;
    pc_tx_func.DiagnosticFuncAddrRq_m_b3 = 0x03;    
    pc_tx_func.DiagnosticFuncAddrRq_m_b4 = 0x00;
	pc_tx_func.DiagnosticFuncAddrRq_m_b5 = 0x00;
    TestStep ("Test Step", "Send:2F E0 03 00");
    output(pc_tx_func);
    rev_flag = TestWaitForMessage(NAV_MSC_FrI00,P2max);
    if(rev_flag == 1)
    {
        TestStepPass("Test Step","There is a response in time");
    }
    else if(rev_flag == 0)
    {
        TestStepFail("Test Step","Wrong!No response");
    }
    else 
    {
        TestStepFail("Test Step", "Error!"); 
    }
    TestStep ("Test Step", "Check the response");
    if((pc_rx_data.DiagnosticRespNAV_b0 == 0x03)&&(pc_rx_data.DiagnosticRespNAV_b1 == 0x7F)&&(pc_rx_data.DiagnosticRespNAV_b2 == 0x2F)&&(pc_rx_data.DiagnosticRespNAV_b3 == 0x7F))
    {
         TestStepPass("Test Step","Response Correct");
    }
    else
    {
        TestStepFail("Test Step","Response Wrong");
    }
	
	
	pc_tx_func.DiagnosticFuncAddrRq_m_b0 = 0x04;
    pc_tx_func.DiagnosticFuncAddrRq_m_b1 = 0x2F;
    pc_tx_func.DiagnosticFuncAddrRq_m_b2 = 0xE0;
    pc_tx_func.DiagnosticFuncAddrRq_m_b3 = 0x03;    
    pc_tx_func.DiagnosticFuncAddrRq_m_b4 = 0x02;
	pc_tx_func.DiagnosticFuncAddrRq_m_b5 = 0x00;
    TestStep ("Test Step", "Send:2F E0 03 02");
    output(pc_tx_func);
    rev_flag = TestWaitForMessage(NAV_MSC_FrI00,P2max);
    if(rev_flag == 1)
    {
        TestStepPass("Test Step","There is a response in time");
    }
    else if(rev_flag == 0)
    {
        TestStepFail("Test Step","Wrong!No response");
    }
    else 
    {
        TestStepFail("Test Step", "Error!"); 
    }
    TestStep ("Test Step", "Check the response");
    if((pc_rx_data.DiagnosticRespNAV_b0 == 0x03)&&(pc_rx_data.DiagnosticRespNAV_b1 == 0x7F)&&(pc_rx_data.DiagnosticRespNAV_b2 == 0x2F)&&(pc_rx_data.DiagnosticRespNAV_b3 == 0x7F))
    {
         TestStepPass("Test Step","Response Correct");
    }
    else
    {
        TestStepFail("Test Step","Response Wrong");
    }
	
	
	pc_tx_func.DiagnosticFuncAddrRq_m_b0 = 0x05;
    pc_tx_func.DiagnosticFuncAddrRq_m_b1 = 0x2F;
    pc_tx_func.DiagnosticFuncAddrRq_m_b2 = 0xE0;
    pc_tx_func.DiagnosticFuncAddrRq_m_b3 = 0x03;    
    pc_tx_func.DiagnosticFuncAddrRq_m_b4 = 0x03;
	pc_tx_func.DiagnosticFuncAddrRq_m_b5 = 0x55;
    TestStep ("Test Step", "Send:2F E0 03 03 55");
    output(pc_tx_func);
    rev_flag = TestWaitForMessage(NAV_MSC_FrI00,P2max);
    if(rev_flag == 1)
    {
        TestStepPass("Test Step","There is a response in time");
    }
    else if(rev_flag == 0)
    {
        TestStepFail("Test Step","Wrong!No response");
    }
    else 
    {
        TestStepFail("Test Step", "Error!"); 
    }
    TestStep ("Test Step", "Check the response");
    if((pc_rx_data.DiagnosticRespNAV_b0 == 0x03)&&(pc_rx_data.DiagnosticRespNAV_b1 == 0x7F)&&(pc_rx_data.DiagnosticRespNAV_b2 == 0x2F)&&(pc_rx_data.DiagnosticRespNAV_b3 == 0x7F))
    {
         TestStepPass("Test Step","Response Correct");
    }
    else
    {
        TestStepFail("Test Step","Response Wrong");
    }
	
	pc_tx_func.DiagnosticFuncAddrRq_m_b0 = 0x04;
    pc_tx_func.DiagnosticFuncAddrRq_m_b1 = 0x2F;
    pc_tx_func.DiagnosticFuncAddrRq_m_b2 = 0xE0;
    pc_tx_func.DiagnosticFuncAddrRq_m_b3 = 0x04;    
    pc_tx_func.DiagnosticFuncAddrRq_m_b4 = 0x00;
	pc_tx_func.DiagnosticFuncAddrRq_m_b5 = 0x00;
    TestStep ("Test Step", "Send:2F E0 04 00");
    output(pc_tx_func);
    rev_flag = TestWaitForMessage(NAV_MSC_FrI00,P2max);
    if(rev_flag == 1)
    {
        TestStepPass("Test Step","There is a response in time");
    }
    else if(rev_flag == 0)
    {
        TestStepFail("Test Step","Wrong!No response");
    }
    else 
    {
        TestStepFail("Test Step", "Error!"); 
    }
    TestStep ("Test Step", "Check the response");
    if((pc_rx_data.DiagnosticRespNAV_b0 == 0x03)&&(pc_rx_data.DiagnosticRespNAV_b1 == 0x7F)&&(pc_rx_data.DiagnosticRespNAV_b2 == 0x2F)&&(pc_rx_data.DiagnosticRespNAV_b3 == 0x7F))
    {
         TestStepPass("Test Step","Response Correct");
    }
    else
    {
        TestStepFail("Test Step","Response Wrong");
    }
	
	
	pc_tx_func.DiagnosticFuncAddrRq_m_b0 = 0x04;
    pc_tx_func.DiagnosticFuncAddrRq_m_b1 = 0x2F;
    pc_tx_func.DiagnosticFuncAddrRq_m_b2 = 0xE0;
    pc_tx_func.DiagnosticFuncAddrRq_m_b3 = 0x04;    
    pc_tx_func.DiagnosticFuncAddrRq_m_b4 = 0x02;
	pc_tx_func.DiagnosticFuncAddrRq_m_b5 = 0x00;
    TestStep ("Test Step", "Send:2F E0 04 02");
    output(pc_tx_func);
    rev_flag = TestWaitForMessage(NAV_MSC_FrI00,P2max);
    if(rev_flag == 1)
    {
        TestStepPass("Test Step","There is a response in time");
    }
    else if(rev_flag == 0)
    {
        TestStepFail("Test Step","Wrong!No response");
    }
    else 
    {
        TestStepFail("Test Step", "Error!"); 
    }
    TestStep ("Test Step", "Check the response");
    if((pc_rx_data.DiagnosticRespNAV_b0 == 0x03)&&(pc_rx_data.DiagnosticRespNAV_b1 == 0x7F)&&(pc_rx_data.DiagnosticRespNAV_b2 == 0x2F)&&(pc_rx_data.DiagnosticRespNAV_b3 == 0x7F))
    {
         TestStepPass("Test Step","Response Correct");
    }
    else
    {
        TestStepFail("Test Step","Response Wrong");
    }
	
	
	pc_tx_func.DiagnosticFuncAddrRq_m_b0 = 0x05;
    pc_tx_func.DiagnosticFuncAddrRq_m_b1 = 0x2F;
    pc_tx_func.DiagnosticFuncAddrRq_m_b2 = 0xE0;
    pc_tx_func.DiagnosticFuncAddrRq_m_b3 = 0x04;    
    pc_tx_func.DiagnosticFuncAddrRq_m_b4 = 0x03;
	pc_tx_func.DiagnosticFuncAddrRq_m_b5 = 0x00;
    TestStep ("Test Step", "Send:2F E0 04 03 00");
    output(pc_tx_func);
    rev_flag = TestWaitForMessage(NAV_MSC_FrI00,P2max);
    if(rev_flag == 1)
    {
        TestStepPass("Test Step","There is a response in time");
    }
    else if(rev_flag == 0)
    {
        TestStepFail("Test Step","Wrong!No response");
    }
    else 
    {
        TestStepFail("Test Step", "Error!"); 
    }
    TestStep ("Test Step", "Check the response");
    if((pc_rx_data.DiagnosticRespNAV_b0 == 0x03)&&(pc_rx_data.DiagnosticRespNAV_b1 == 0x7F)&&(pc_rx_data.DiagnosticRespNAV_b2 == 0x2F)&&(pc_rx_data.DiagnosticRespNAV_b3 == 0x7F))
    {
         TestStepPass("Test Step","Response Correct");
    }
    else
    {
        TestStepFail("Test Step","Response Wrong");
    }
	
	
	pc_tx_func.DiagnosticFuncAddrRq_m_b0 = 0x05;
    pc_tx_func.DiagnosticFuncAddrRq_m_b1 = 0x2F;
    pc_tx_func.DiagnosticFuncAddrRq_m_b2 = 0xE0;
    pc_tx_func.DiagnosticFuncAddrRq_m_b3 = 0x04;    
    pc_tx_func.DiagnosticFuncAddrRq_m_b4 = 0x03;
	pc_tx_func.DiagnosticFuncAddrRq_m_b5 = 0x01;
    TestStep ("Test Step", "Send:2F E0 04 03 01");
    output(pc_tx_func);
    rev_flag = TestWaitForMessage(NAV_MSC_FrI00,P2max);
    if(rev_flag == 1)
    {
        TestStepPass("Test Step","There is a response in time");
    }
    else if(rev_flag == 0)
    {
        TestStepFail("Test Step","Wrong!No response");
    }
    else 
    {
        TestStepFail("Test Step", "Error!"); 
    }
    TestStep ("Test Step", "Check the response");
    if((pc_rx_data.DiagnosticRespNAV_b0 == 0x03)&&(pc_rx_data.DiagnosticRespNAV_b1 == 0x7F)&&(pc_rx_data.DiagnosticRespNAV_b2 == 0x2F)&&(pc_rx_data.DiagnosticRespNAV_b3 == 0x7F))
    {
         TestStepPass("Test Step","Response Correct");
    }
    else
    {
        TestStepFail("Test Step","Response Wrong");
    }
	
	
	pc_tx_func.DiagnosticFuncAddrRq_m_b0 = 0x05;
    pc_tx_func.DiagnosticFuncAddrRq_m_b1 = 0x2F;
    pc_tx_func.DiagnosticFuncAddrRq_m_b2 = 0xE0;
    pc_tx_func.DiagnosticFuncAddrRq_m_b3 = 0x04;    
    pc_tx_func.DiagnosticFuncAddrRq_m_b4 = 0x03;
	pc_tx_func.DiagnosticFuncAddrRq_m_b5 = 0x02;
    TestStep ("Test Step", "Send:2F E0 04 03 02");
    output(pc_tx_func);
    rev_flag = TestWaitForMessage(NAV_MSC_FrI00,P2max);
    if(rev_flag == 1)
    {
        TestStepPass("Test Step","There is a response in time");
    }
    else if(rev_flag == 0)
    {
        TestStepFail("Test Step","Wrong!No response");
    }
    else 
    {
        TestStepFail("Test Step", "Error!"); 
    }
    TestStep ("Test Step", "Check the response");
    if((pc_rx_data.DiagnosticRespNAV_b0 == 0x03)&&(pc_rx_data.DiagnosticRespNAV_b1 == 0x7F)&&(pc_rx_data.DiagnosticRespNAV_b2 == 0x2F)&&(pc_rx_data.DiagnosticRespNAV_b3 == 0x7F))
    {
         TestStepPass("Test Step","Response Correct");
    }
    else
    {
        TestStepFail("Test Step","Response Wrong");
    }
	
	
	pc_tx_func.DiagnosticFuncAddrRq_m_b0 = 0x04;
    pc_tx_func.DiagnosticFuncAddrRq_m_b1 = 0x2F;
    pc_tx_func.DiagnosticFuncAddrRq_m_b2 = 0xE0;
    pc_tx_func.DiagnosticFuncAddrRq_m_b3 = 0x05;    
    pc_tx_func.DiagnosticFuncAddrRq_m_b4 = 0x00;
	pc_tx_func.DiagnosticFuncAddrRq_m_b5 = 0x00;
    TestStep ("Test Step", "Send:2F E0 05 00");
    output(pc_tx_func);
    rev_flag = TestWaitForMessage(NAV_MSC_FrI00,P2max);
    if(rev_flag == 1)
    {
        TestStepPass("Test Step","There is a response in time");
    }
    else if(rev_flag == 0)
    {
        TestStepFail("Test Step","Wrong!No response");
    }
    else 
    {
        TestStepFail("Test Step", "Error!"); 
    }
    TestStep ("Test Step", "Check the response");
    if((pc_rx_data.DiagnosticRespNAV_b0 == 0x03)&&(pc_rx_data.DiagnosticRespNAV_b1 == 0x7F)&&(pc_rx_data.DiagnosticRespNAV_b2 == 0x2F)&&(pc_rx_data.DiagnosticRespNAV_b3 == 0x7F))
    {
         TestStepPass("Test Step","Response Correct");
    }
    else
    {
        TestStepFail("Test Step","Response Wrong");
    }
	
	
	pc_tx_func.DiagnosticFuncAddrRq_m_b0 = 0x04;
    pc_tx_func.DiagnosticFuncAddrRq_m_b1 = 0x2F;
    pc_tx_func.DiagnosticFuncAddrRq_m_b2 = 0xE0;
    pc_tx_func.DiagnosticFuncAddrRq_m_b3 = 0x05;    
    pc_tx_func.DiagnosticFuncAddrRq_m_b4 = 0x02;
	pc_tx_func.DiagnosticFuncAddrRq_m_b5 = 0x00;
    TestStep ("Test Step", "Send:2F E0 05 02");
    output(pc_tx_func);
    rev_flag = TestWaitForMessage(NAV_MSC_FrI00,P2max);
    if(rev_flag == 1)
    {
        TestStepPass("Test Step","There is a response in time");
    }
    else if(rev_flag == 0)
    {
        TestStepFail("Test Step","Wrong!No response");
    }
    else 
    {
        TestStepFail("Test Step", "Error!"); 
    }
    TestStep ("Test Step", "Check the response");
    if((pc_rx_data.DiagnosticRespNAV_b0 == 0x03)&&(pc_rx_data.DiagnosticRespNAV_b1 == 0x7F)&&(pc_rx_data.DiagnosticRespNAV_b2 == 0x2F)&&(pc_rx_data.DiagnosticRespNAV_b3 == 0x7F))
    {
         TestStepPass("Test Step","Response Correct");
    }
    else
    {
        TestStepFail("Test Step","Response Wrong");
    }
	
	
	pc_tx_func.DiagnosticFuncAddrRq_m_b0 = 0x05;
    pc_tx_func.DiagnosticFuncAddrRq_m_b1 = 0x2F;
    pc_tx_func.DiagnosticFuncAddrRq_m_b2 = 0xE0;
    pc_tx_func.DiagnosticFuncAddrRq_m_b3 = 0x05;    
    pc_tx_func.DiagnosticFuncAddrRq_m_b4 = 0x03;
	pc_tx_func.DiagnosticFuncAddrRq_m_b5 = 0x00;
    TestStep ("Test Step", "Send:2F E0 05 03 00");
    output(pc_tx_func);
    rev_flag = TestWaitForMessage(NAV_MSC_FrI00,P2max);
    if(rev_flag == 1)
    {
        TestStepPass("Test Step","There is a response in time");
    }
    else if(rev_flag == 0)
    {
        TestStepFail("Test Step","Wrong!No response");
    }
    else 
    {
        TestStepFail("Test Step", "Error!"); 
    }
    TestStep ("Test Step", "Check the response");
    if((pc_rx_data.DiagnosticRespNAV_b0 == 0x03)&&(pc_rx_data.DiagnosticRespNAV_b1 == 0x7F)&&(pc_rx_data.DiagnosticRespNAV_b2 == 0x2F)&&(pc_rx_data.DiagnosticRespNAV_b3 == 0x7F))
    {
         TestStepPass("Test Step","Response Correct");
    }
    else
    {
        TestStepFail("Test Step","Response Wrong");
    }
	
	
	pc_tx_func.DiagnosticFuncAddrRq_m_b0 = 0x05;
    pc_tx_func.DiagnosticFuncAddrRq_m_b1 = 0x2F;
    pc_tx_func.DiagnosticFuncAddrRq_m_b2 = 0xE0;
    pc_tx_func.DiagnosticFuncAddrRq_m_b3 = 0x05;    
    pc_tx_func.DiagnosticFuncAddrRq_m_b4 = 0x03;
	pc_tx_func.DiagnosticFuncAddrRq_m_b5 = 0x01;
    TestStep ("Test Step", "Send:2F E0 05 03 01");
    output(pc_tx_func);
    rev_flag = TestWaitForMessage(NAV_MSC_FrI00,P2max);
    if(rev_flag == 1)
    {
        TestStepPass("Test Step","There is a response in time");
    }
    else if(rev_flag == 0)
    {
        TestStepFail("Test Step","Wrong!No response");
    }
    else 
    {
        TestStepFail("Test Step", "Error!"); 
    }
    TestStep ("Test Step", "Check the response");
    if((pc_rx_data.DiagnosticRespNAV_b0 == 0x03)&&(pc_rx_data.DiagnosticRespNAV_b1 == 0x7F)&&(pc_rx_data.DiagnosticRespNAV_b2 == 0x2F)&&(pc_rx_data.DiagnosticRespNAV_b3 == 0x7F))
    {
         TestStepPass("Test Step","Response Correct");
    }
    else
    {
        TestStepFail("Test Step","Response Wrong");
    }
	
	
	
}

