variables
{
    message     NAV_MSC_FrI00  pc_rx_data;
    message     DIAG_MSC_FrI00 pc_tx_func;
    message     DIAG_MSC_FrI02 pc_tx_phys;
	byte		Long_Txdata[4096];
	byte		Long_Rxdata[4096];
    const long P2max = 50;
    const long P2smax =500;
}

void MainTest()
{
    TestModuleTitle ("UDS on CAN Request&Response Test");
    TestModuleDescription (" Default Diagnostic Session, Physical Addressing.SID=ReadDataByIdentifier");
    TestGroupBegin("CAN Diagnostic Message Test", "Test the ReadDataByIdentifier service");
    ReadDataByIdentifier_Test();
    TestGroupEnd(); 
}

on message NAV_MSC_FrI00
{
     pc_rx_data = this;
}

testcase ReadDataByIdentifier_Test ()
{
    long rev_flag = 0;
	int message_num=0;
	
    pc_tx_phys.DiagnosticReqNAV_b0 = 0x03;
    pc_tx_phys.DiagnosticReqNAV_b1 = 0x22;
    pc_tx_phys.DiagnosticReqNAV_b2 = 0xf1;
    pc_tx_phys.DiagnosticReqNAV_b3 = 0x20;
	
    TestCaseTitle("ReadDataByIdentifier TEST", "Request and check the response");
    TestCaseDescription("send a request and receive a response,then check the response");
    TestStep ("Test Step", "Send:22 f1 20");
	
    output(pc_tx_phys);
    rev_flag = TestWaitForMessage(NAV_MSC_FrI00,P2max);
    if(rev_flag == 1)
    {
        TestStepPass("Test Step","There is a response in time");
		
		if((pc_rx_data.DiagnosticRespNAV_b0 == 0x04)&&(pc_rx_data.DiagnosticRespNAV_b1 == 0x62)&&(pc_rx_data.DiagnosticRespNAV_b2 == 0x01)&&(pc_rx_data.DiagnosticRespNAV_b3 == 0x12))
	    {
			TestStepPass("Test Step","Response Correct");
	    }
	    else
	    {
	        TestStepFail("Test Step","Response Wrong");
	    }
    }
    else if(rev_flag == 0)
    {
        TestStepFail("Test Step","Wrong!No response");
    }
    else 
    {
        TestStepFail("Test Step", "Error!"); 
    }
    TestStep ("Test Step", "Check the response");
   
}

