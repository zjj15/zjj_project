variables
{
    message     NAV_MSC_FrI00  pc_rx_data;
    message     DIAG_MSC_FrI00 pc_tx_func;
    message     DIAG_MSC_FrI02 pc_tx_phys;
	byte		Long_Txdata[4096];
	byte		Long_Rxdata[4096];
    const long P2max = 40;
    const long P2smax = 40;
}

void MainTest()
{
    TestModuleTitle ("UDS on CAN Request&Response Test");
    TestModuleDescription (" Default Diagnostic Session, Physical Addressing.SID=CommunicationControl");
    TestGroupBegin("CAN Diagnostic Message Test", "Test the DiagnosticSessionControl service");
    CommunicationControl_Test();
    TestGroupEnd(); 
}

on message NAV_MSC_FrI00
{
     pc_rx_data = this;
}

testcase CommunicationControl_Test ()
{
    long rev_flag = 0;
    long p2max = 0;
    long p2smax = 0;
    TestCaseTitle("SecurityAccess TEST(Phys)", "Send wrong request , check the NRC");
    TestCaseDescription("send a wrong request and receive a response,then check if the negative response is right");
    

    /*TestStep 2*/
    TestStep ("Test Step", "Send:03 28 00 01 00 00 00 00");
    pc_tx_phys.DiagnosticReqNAV_b0 = 0x03;
    pc_tx_phys.DiagnosticReqNAV_b1 = 0x28;
    pc_tx_phys.DiagnosticReqNAV_b2 = 0x00;
    pc_tx_phys.DiagnosticReqNAV_b3 = 0x01;
    pc_tx_phys.DiagnosticReqNAV_b4 = 0x00;
    pc_tx_phys.DiagnosticReqNAV_b5 = 0x00;
    pc_tx_phys.DiagnosticReqNAV_b6 = 0x00;
    pc_tx_phys.DiagnosticReqNAV_b7 = 0x00;
    output(pc_tx_phys);
    rev_flag = TestWaitForMessage(NAV_MSC_FrI00,40);
    if(rev_flag == 1)
    {
        TestStepPass("Test Step","There is a response in time");
    }
    else if(rev_flag == 0)
    {
        TestStepFail("Test Step","Wrong!No response");
    }
    else 
    {
        TestStepFail("Test Step", "Error!"); 
    }
    TestStep ("Test Step", "Check the response");
    if((pc_rx_data.DiagnosticRespNAV_b0 == 0x03)&&(pc_rx_data.DiagnosticRespNAV_b1 == 0x7F)&&(pc_rx_data.DiagnosticRespNAV_b2 == 0x28)&&(pc_rx_data.DiagnosticRespNAV_b3 == 0x7F))
    {
        
           TestStepPass("Test Step","NRC = 0x7F Response Correct");
    }
    else
    {
           TestStepFail("Test Step","Response Wrong");
    }

	/*TestStep 3*/
    TestStep ("Test Step", "Send:03 28 80 01 00 00 00 00");
    pc_tx_phys.DiagnosticReqNAV_b0 = 0x03;
    pc_tx_phys.DiagnosticReqNAV_b1 = 0x28;
    pc_tx_phys.DiagnosticReqNAV_b2 = 0x80;
    pc_tx_phys.DiagnosticReqNAV_b3 = 0x01;
    pc_tx_phys.DiagnosticReqNAV_b4 = 0x00;
    pc_tx_phys.DiagnosticReqNAV_b5 = 0x00;
    pc_tx_phys.DiagnosticReqNAV_b6 = 0x00;
    pc_tx_phys.DiagnosticReqNAV_b7 = 0x00;
    output(pc_tx_phys);
    rev_flag = TestWaitForMessage(NAV_MSC_FrI00,40);
    if(rev_flag == 1)
    {
        TestStepPass("Test Step","There is a response in time");
    }
    else if(rev_flag == 0)
    {
        TestStepFail("Test Step","Wrong!No response");
    }
    else 
    {
        TestStepFail("Test Step", "Error!"); 
    }
    TestStep ("Test Step", "Check the response");
    if((pc_rx_data.DiagnosticRespNAV_b0 == 0x03)&&(pc_rx_data.DiagnosticRespNAV_b1 == 0x7F)&&(pc_rx_data.DiagnosticRespNAV_b2 == 0x28)&&(pc_rx_data.DiagnosticRespNAV_b3 == 0x7F))
    {
        
           TestStepPass("Test Step","NRC = 0x7F Response Correct");
    }
    else
    {
           TestStepFail("Test Step","Response Wrong");
    }
	
    /*TestStep 4*/
    TestStep ("Test Step", "Send:03 28 03 01 00 00 00 00");
    pc_tx_phys.DiagnosticReqNAV_b0 = 0x03;
    pc_tx_phys.DiagnosticReqNAV_b1 = 0x28;
    pc_tx_phys.DiagnosticReqNAV_b2 = 0x03;
    pc_tx_phys.DiagnosticReqNAV_b3 = 0x01;
    pc_tx_phys.DiagnosticReqNAV_b4 = 0x00;
    pc_tx_phys.DiagnosticReqNAV_b5 = 0x00;
    pc_tx_phys.DiagnosticReqNAV_b6 = 0x00;
    pc_tx_phys.DiagnosticReqNAV_b7 = 0x00;
    output(pc_tx_phys);
    rev_flag = TestWaitForMessage(NAV_MSC_FrI00,40);
    if(rev_flag == 1)
    {
        TestStepPass("Test Step","There is a response in time");
    }
    else if(rev_flag == 0)
    {
        TestStepFail("Test Step","Wrong!No response");
    }
    else 
    {
        TestStepFail("Test Step", "Error!"); 
    }
    TestStep ("Test Step", "Check the response");
    if((pc_rx_data.DiagnosticRespNAV_b0 == 0x03)&&(pc_rx_data.DiagnosticRespNAV_b1 == 0x7F)&&(pc_rx_data.DiagnosticRespNAV_b2 == 0x28)&&(pc_rx_data.DiagnosticRespNAV_b3 == 0x7F))
    {
        
           TestStepPass("Test Step","NRC = 0x7F Response Correct");
    }
    else
    {
           TestStepFail("Test Step","Response Wrong");
    }

    /*TestStep 5*/
    TestStep ("Test Step", "Send:03 28 83 01 00 00 00 00");
    pc_tx_phys.DiagnosticReqNAV_b0 = 0x03;
    pc_tx_phys.DiagnosticReqNAV_b1 = 0x28;
    pc_tx_phys.DiagnosticReqNAV_b2 = 0x83;
    pc_tx_phys.DiagnosticReqNAV_b3 = 0x01;
    pc_tx_phys.DiagnosticReqNAV_b4 = 0x00;
    pc_tx_phys.DiagnosticReqNAV_b5 = 0x00;
    pc_tx_phys.DiagnosticReqNAV_b6 = 0x00;
    pc_tx_phys.DiagnosticReqNAV_b7 = 0x00;
    output(pc_tx_phys);
    rev_flag = TestWaitForMessage(NAV_MSC_FrI00,40);
    if(rev_flag == 1)
    {
        TestStepPass("Test Step","There is a response in time");
    }
    else if(rev_flag == 0)
    {
        TestStepFail("Test Step","Wrong!No response");
    }
    else 
    {
        TestStepFail("Test Step", "Error!"); 
    }
    TestStep ("Test Step", "Check the response");
    if((pc_rx_data.DiagnosticRespNAV_b0 == 0x03)&&(pc_rx_data.DiagnosticRespNAV_b1 == 0x7F)&&(pc_rx_data.DiagnosticRespNAV_b2 == 0x28)&&(pc_rx_data.DiagnosticRespNAV_b3 == 0x7F))
    {
        
           TestStepPass("Test Step","NRC = 0x7F Response Correct");
    }
    else
    {
           TestStepFail("Test Step","Response Wrong");
    }

}

