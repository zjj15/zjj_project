variables
{
    message     NAV_MSC_FrI00  pc_rx_data;
    message     DIAG_MSC_FrI00 pc_tx_func;
    message     DIAG_MSC_FrI02 pc_tx_phys;
	byte		Long_Txdata[4096];
	byte		Long_Rxdata[4096];
    const long P2max = 40;
    const long P2smax = 40;
}

void MainTest()
{
    TestModuleTitle ("UDS on CAN Request&Response Test");
    TestModuleDescription (" Default Diagnostic Session, Physical Addressing.SID=RoutineControl");
    TestGroupBegin("CAN Diagnostic Message Test", "Test the RoutineControl service");
    RoutineControl_Test();
    TestGroupEnd(); 
}

on message NAV_MSC_FrI00
{
     pc_rx_data = this;
}

testcase RoutineControl_Test ()
{
    long rev_flag = 0;
   
    TestCaseTitle("RoutineControl TEST", "Request and check the response");
    TestCaseDescription("send a request and receive a response,then check the response");
    TestStep ("Test Step", "Send:31 01 AF 01");
    pc_tx_phys.DiagnosticReqNAV_b0 = 0x04;
    pc_tx_phys.DiagnosticReqNAV_b1 = 0x31;
    pc_tx_phys.DiagnosticReqNAV_b2 = 0x01;
    pc_tx_phys.DiagnosticReqNAV_b3 = 0xAF;    
    pc_tx_phys.DiagnosticReqNAV_b4 = 0x01;
    output(pc_tx_phys);
    rev_flag = TestWaitForMessage(NAV_MSC_FrI00,P2max);
    if(rev_flag == 1)
    {
        TestStepPass("Test Step","There is a response in time");
    }
    else if(rev_flag == 0)
    {
        TestStepFail("Test Step","Wrong!No response");
    }
    else 
    {
        TestStepFail("Test Step", "Error!"); 
    }
    TestStep ("Test Step", "Check the response");
    if((pc_rx_data.DiagnosticRespNAV_b0 == 0x03)&&(pc_rx_data.DiagnosticRespNAV_b1 == 0x7F)&&(pc_rx_data.DiagnosticRespNAV_b2 == 0x31)&&(pc_rx_data.DiagnosticRespNAV_b3 == 0x7F))
    {
         TestStepPass("Test Step","Response Correct");
    }
    else
    {
        TestStepFail("Test Step","Response Wrong");
    }
    TestWaitForTimeout(100);
	
	
	TestCaseTitle("RoutineControl TEST", "Request and check the response");
    TestCaseDescription("send a request and receive a response,then check the response");
    TestStep ("Test Step", "Send:31 81 AF 01");
    pc_tx_phys.DiagnosticReqNAV_b0 = 0x04;
    pc_tx_phys.DiagnosticReqNAV_b1 = 0x31;
    pc_tx_phys.DiagnosticReqNAV_b2 = 0x81;
    pc_tx_phys.DiagnosticReqNAV_b3 = 0xAF;    
    pc_tx_phys.DiagnosticReqNAV_b4 = 0x01;
    output(pc_tx_phys);
    rev_flag = TestWaitForMessage(NAV_MSC_FrI00,P2max);
    if(rev_flag == 1)
    {
        TestStepPass("Test Step","There is a response in time");
    }
    else if(rev_flag == 0)
    {
        TestStepFail("Test Step","Wrong!No response");
    }
    else 
    {
        TestStepFail("Test Step", "Error!"); 
    }
    TestStep ("Test Step", "Check the response");
    if((pc_rx_data.DiagnosticRespNAV_b0 == 0x03)&&(pc_rx_data.DiagnosticRespNAV_b1 == 0x7F)&&(pc_rx_data.DiagnosticRespNAV_b2 == 0x31)&&(pc_rx_data.DiagnosticRespNAV_b3 == 0x7F))
    {
         TestStepPass("Test Step","Response Correct");
    }
    else
    {
        TestStepFail("Test Step","Response Wrong");
    }
    TestWaitForTimeout(100);
	
	
   TestStep ("Test Step", "Send:31 02 AF 01");
    pc_tx_phys.DiagnosticReqNAV_b0 = 0x04;
    pc_tx_phys.DiagnosticReqNAV_b1 = 0x31;
    pc_tx_phys.DiagnosticReqNAV_b2 = 0x02;
    pc_tx_phys.DiagnosticReqNAV_b3 = 0xAF;    
    pc_tx_phys.DiagnosticReqNAV_b4 = 0x01;
    output(pc_tx_phys);
    rev_flag = TestWaitForMessage(NAV_MSC_FrI00,P2max);
    if(rev_flag == 1)
    {
        TestStepPass("Test Step","There is a response in time");
    }
    else if(rev_flag == 0)
    {
        TestStepFail("Test Step","Wrong!No response");
    }
    else 
    {
        TestStepFail("Test Step", "Error!"); 
    }
    TestStep ("Test Step", "Check the response");
    if((pc_rx_data.DiagnosticRespNAV_b0 == 0x03)&&(pc_rx_data.DiagnosticRespNAV_b1 == 0x7F)&&(pc_rx_data.DiagnosticRespNAV_b2 == 0x31)&&(pc_rx_data.DiagnosticRespNAV_b3 == 0x7F))
    {
         TestStepPass("Test Step","Response Correct");
    }
    else
    {
        TestStepFail("Test Step","Response Wrong");
    }
    TestWaitForTimeout(100);
	
	
	TestStep ("Test Step", "Send:31 82 AF 01");
    pc_tx_phys.DiagnosticReqNAV_b0 = 0x04;
    pc_tx_phys.DiagnosticReqNAV_b1 = 0x31;
    pc_tx_phys.DiagnosticReqNAV_b2 = 0x82;
    pc_tx_phys.DiagnosticReqNAV_b3 = 0xAF;    
    pc_tx_phys.DiagnosticReqNAV_b4 = 0x01;
    output(pc_tx_phys);
    rev_flag = TestWaitForMessage(NAV_MSC_FrI00,P2max);
    if(rev_flag == 1)
    {
        TestStepPass("Test Step","There is a response in time");
    }
    else if(rev_flag == 0)
    {
        TestStepFail("Test Step","Wrong!No response");
    }
    else 
    {
        TestStepFail("Test Step", "Error!"); 
    }
    TestStep ("Test Step", "Check the response");
    if((pc_rx_data.DiagnosticRespNAV_b0 == 0x03)&&(pc_rx_data.DiagnosticRespNAV_b1 == 0x7F)&&(pc_rx_data.DiagnosticRespNAV_b2 == 0x31)&&(pc_rx_data.DiagnosticRespNAV_b3 == 0x7F))
    {
         TestStepPass("Test Step","Response Correct");
    }
    else
    {
        TestStepFail("Test Step","Response Wrong");
    }
    TestWaitForTimeout(100);
	
	
   TestStep ("Test Step", "Send:31 03 AF 01");
    pc_tx_phys.DiagnosticReqNAV_b0 = 0x04;
    pc_tx_phys.DiagnosticReqNAV_b1 = 0x31;
    pc_tx_phys.DiagnosticReqNAV_b2 = 0x03;
    pc_tx_phys.DiagnosticReqNAV_b3 = 0xAF;    
    pc_tx_phys.DiagnosticReqNAV_b4 = 0x01;
    output(pc_tx_phys);
    rev_flag = TestWaitForMessage(NAV_MSC_FrI00,P2max);
    if(rev_flag == 1)
    {
        TestStepPass("Test Step","There is a response in time");
    }
    else if(rev_flag == 0)
    {
        TestStepFail("Test Step","Wrong!No response");
    }
    else 
    {
        TestStepFail("Test Step", "Error!"); 
    }
    TestStep ("Test Step", "Check the response");
    if((pc_rx_data.DiagnosticRespNAV_b0 == 0x03)&&(pc_rx_data.DiagnosticRespNAV_b1 == 0x7F)&&(pc_rx_data.DiagnosticRespNAV_b2 == 0x31)&&(pc_rx_data.DiagnosticRespNAV_b3 == 0x7F))
    {
         TestStepPass("Test Step","Response Correct");
    }
    else
    {
        TestStepFail("Test Step","Response Wrong");
    }
	
	
	TestStep ("Test Step", "Send:31 83 AF 01");
    pc_tx_phys.DiagnosticReqNAV_b0 = 0x04;
    pc_tx_phys.DiagnosticReqNAV_b1 = 0x31;
    pc_tx_phys.DiagnosticReqNAV_b2 = 0x83;
    pc_tx_phys.DiagnosticReqNAV_b3 = 0xAF;    
    pc_tx_phys.DiagnosticReqNAV_b4 = 0x01;
    output(pc_tx_phys);
    rev_flag = TestWaitForMessage(NAV_MSC_FrI00,P2max);
    if(rev_flag == 1)
    {
        TestStepPass("Test Step","There is a response in time");
    }
    else if(rev_flag == 0)
    {
        TestStepFail("Test Step","Wrong!No response");
    }
    else 
    {
        TestStepFail("Test Step", "Error!"); 
    }
    TestStep ("Test Step", "Check the response");
    if((pc_rx_data.DiagnosticRespNAV_b0 == 0x03)&&(pc_rx_data.DiagnosticRespNAV_b1 == 0x7F)&&(pc_rx_data.DiagnosticRespNAV_b2 == 0x31)&&(pc_rx_data.DiagnosticRespNAV_b3 == 0x7F))
    {
         TestStepPass("Test Step","Response Correct");
    }
    else
    {
        TestStepFail("Test Step","Response Wrong");
    }
}

