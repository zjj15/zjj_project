includes
{

}

variables
{
    message     NAV_MSC_FrI00  pc_rx_data;
    message     DIAG_MSC_FrI00 pc_tx_func;
    message     DIAG_MSC_FrI02 pc_tx_phys;
    byte		Long_Txdata[4096];
    byte		Long_Rxdata[4096];
    long P2max = 0;
    long P2smax = 0;
    byte  op_cnt;
}

void MainTest ()
{
	  TestModuleTitle ("DTC Test");
    TestModuleDescription ("BCM Miss Test");
    TestGroupBegin("DTC Test", "Test the BCM Miss DTC");
    BCMMiss ();
    TestGroupEnd(); 

}

testcase BCMMiss()
{
	   long rev_flag = 0;
    
    TestCaseTitle("DTC Test", "BCM Miss Test");
    TestCaseDescription("Check the DTC detection & aging");
    /*TestStep 1*/
    TestStep ("Test Step", "Clear all DTC information of ECU");
    pc_tx_phys.DiagnosticReqNAV_b0 = 0x04;
    pc_tx_phys.DiagnosticReqNAV_b1 = 0x14;
    pc_tx_phys.DiagnosticReqNAV_b2 = 0xFF;
    pc_tx_phys.DiagnosticReqNAV_b3 = 0xFF;
    pc_tx_phys.DiagnosticReqNAV_b4 = 0xFF;
    pc_tx_phys.DiagnosticReqNAV_b5 = 0x00;
    pc_tx_phys.DiagnosticReqNAV_b6 = 0x00;
    pc_tx_phys.DiagnosticReqNAV_b7 = 0x00;
    output(pc_tx_phys);
    rev_flag = TestWaitForMessage(NAV_MSC_FrI00,50);
    if(rev_flag == 1)
    {
        TestStepPass("Test Step","There is a response in time");
    }
    else if(rev_flag == 0)
    {
        TestStepFail("Test Step","Wrong!No response");
    }
    else 
    {
        TestStepFail("Test Step", "Error!"); 
    }
    /*TestStep 2*/
    write("Make the BCM Miss");
    testWaitForTimeout(10000);
    TestStepPass("Test Step","Wait for you");
    /*TestStep 3*/
    TestStep ("Test Step", "Read DTC by status mask(0x0C)");
    pc_tx_phys.DiagnosticReqNAV_b0 = 0x03;
    pc_tx_phys.DiagnosticReqNAV_b1 = 0x19;
    pc_tx_phys.DiagnosticReqNAV_b2 = 0x02;
    pc_tx_phys.DiagnosticReqNAV_b3 = 0x0C;
    pc_tx_phys.DiagnosticReqNAV_b4 = 0x00;
    pc_tx_phys.DiagnosticReqNAV_b5 = 0x00;
    pc_tx_phys.DiagnosticReqNAV_b6 = 0x00;
    pc_tx_phys.DiagnosticReqNAV_b7 = 0x00;
    output(pc_tx_phys);
    rev_flag = TestWaitForMessage(NAV_MSC_FrI00,50);
    if(rev_flag == 1)
    {
        TestStepPass("Test Step","There is a response in time");
    }
    else if(rev_flag == 0)
    {
        TestStepFail("Test Step","Wrong!No response");
    }
    else 
    {
        TestStepFail("Test Step", "Error!"); 
    }
    /*TestStep 4*/
    TestStep ("Test Step", "Read the DTC's snapshot information & extened data");
    pc_tx_phys.DiagnosticReqNAV_b0 = 0x06;
    pc_tx_phys.DiagnosticReqNAV_b1 = 0x19;
    pc_tx_phys.DiagnosticReqNAV_b2 = 0x04;
    pc_tx_phys.DiagnosticReqNAV_b3 = 0xC1;
    pc_tx_phys.DiagnosticReqNAV_b4 = 0x40;
    pc_tx_phys.DiagnosticReqNAV_b5 = 0x87;
    pc_tx_phys.DiagnosticReqNAV_b6 = 0xFF;
    pc_tx_phys.DiagnosticReqNAV_b7 = 0x00;
    output(pc_tx_phys);
    rev_flag = TestWaitForMessage(NAV_MSC_FrI00,50);
    if(rev_flag == 1)
    {
        TestStepPass("Test Step","There is a response in time");
    }
    else if(rev_flag == 0)
    {
        TestStepFail("Test Step","Wrong!No response");
    }
    else 
    {
        TestStepFail("Test Step", "Error!"); 
    }
    testWaitForTimeout(1000);
    pc_tx_phys.DiagnosticReqNAV_b0 = 0x06;
    pc_tx_phys.DiagnosticReqNAV_b1 = 0x19;
    pc_tx_phys.DiagnosticReqNAV_b2 = 0x06;
    pc_tx_phys.DiagnosticReqNAV_b3 = 0xC1;
    pc_tx_phys.DiagnosticReqNAV_b4 = 0x40;
    pc_tx_phys.DiagnosticReqNAV_b5 = 0x87;
    pc_tx_phys.DiagnosticReqNAV_b6 = 0x01;
    pc_tx_phys.DiagnosticReqNAV_b7 = 0x00;
    output(pc_tx_phys);
    rev_flag = TestWaitForMessage(NAV_MSC_FrI00,50);
    if(rev_flag == 1)
    {
        TestStepPass("Test Step","There is a response in time");
    }
    else if(rev_flag == 0)
    {
        TestStepFail("Test Step","Wrong!No response");
    }
    else 
    {
        TestStepFail("Test Step", "Error!"); 
    }
    testWaitForTimeout(1000);
    /*TestStep 5*/
    write("Make the BCM Miss Test OK");
    testWaitForTimeout(5000);
    TestStepPass("Test Step","Wait for you");
    /*TestStep 6*/
    TestStep ("Test Step", "Read the DTC's snapshot information & extened data");
    pc_tx_phys.DiagnosticReqNAV_b0 = 0x06;
    pc_tx_phys.DiagnosticReqNAV_b1 = 0x19;
    pc_tx_phys.DiagnosticReqNAV_b2 = 0x04;
    pc_tx_phys.DiagnosticReqNAV_b3 = 0xC1;
    pc_tx_phys.DiagnosticReqNAV_b4 = 0x40;
    pc_tx_phys.DiagnosticReqNAV_b5 = 0x87;
    pc_tx_phys.DiagnosticReqNAV_b6 = 0xFF;
    pc_tx_phys.DiagnosticReqNAV_b7 = 0x00;
    output(pc_tx_phys);
    rev_flag = TestWaitForMessage(NAV_MSC_FrI00,50);
    if(rev_flag == 1)
    {
        TestStepPass("Test Step","There is a response in time");
    }
    else if(rev_flag == 0)
    {
        TestStepFail("Test Step","Wrong!No response");
    }
    else 
    {
        TestStepFail("Test Step", "Error!"); 
    }
    testWaitForTimeout(1000);
    pc_tx_phys.DiagnosticReqNAV_b0 = 0x06;
    pc_tx_phys.DiagnosticReqNAV_b1 = 0x19;
    pc_tx_phys.DiagnosticReqNAV_b2 = 0x06;
    pc_tx_phys.DiagnosticReqNAV_b3 = 0xC1;
    pc_tx_phys.DiagnosticReqNAV_b4 = 0x40;
    pc_tx_phys.DiagnosticReqNAV_b5 = 0x87;
    pc_tx_phys.DiagnosticReqNAV_b6 = 0x01;
    pc_tx_phys.DiagnosticReqNAV_b7 = 0x00;
    output(pc_tx_phys);
    rev_flag = TestWaitForMessage(NAV_MSC_FrI00,50);
    if(rev_flag == 1)
    {
        TestStepPass("Test Step","There is a response in time");
    }
    else if(rev_flag == 0)
    {
        TestStepFail("Test Step","Wrong!No response");
    }
    else 
    {
        TestStepFail("Test Step", "Error!"); 
    }
        testWaitForTimeout(5000);
        putvalue(Ev_Restart_Flag,1);
        testWaitForTimeout(20000);
        putvalue(Ev_Restart_Flag,0);
        testWaitForTimeout(10000);

    for(op_cnt = 0;op_cnt<43;op_cnt++)
    {
    
        TestStep ("Test Step", "Read the DTC's snapshot information & extened data");
        pc_tx_phys.DiagnosticReqNAV_b0 = 0x06;
        pc_tx_phys.DiagnosticReqNAV_b1 = 0x19;
        pc_tx_phys.DiagnosticReqNAV_b2 = 0x04;
        pc_tx_phys.DiagnosticReqNAV_b3 = 0xC1;
        pc_tx_phys.DiagnosticReqNAV_b4 = 0x40;
        pc_tx_phys.DiagnosticReqNAV_b5 = 0x87;
        pc_tx_phys.DiagnosticReqNAV_b6 = 0xFF;
        pc_tx_phys.DiagnosticReqNAV_b7 = 0x00;
        output(pc_tx_phys);
        rev_flag = TestWaitForMessage(NAV_MSC_FrI00,50);
        if(rev_flag == 1)
        {
            TestStepPass("Test Step","There is a response in time");
        }
        else if(rev_flag == 0)
        {
            TestStepFail("Test Step","Wrong!No response");
        }
        else 
        {
            TestStepFail("Test Step", "Error!"); 
        }
        testWaitForTimeout(1000);
        pc_tx_phys.DiagnosticReqNAV_b0 = 0x06;
        pc_tx_phys.DiagnosticReqNAV_b1 = 0x19;
        pc_tx_phys.DiagnosticReqNAV_b2 = 0x06;
        pc_tx_phys.DiagnosticReqNAV_b3 = 0xC1;
        pc_tx_phys.DiagnosticReqNAV_b4 = 0x40;
        pc_tx_phys.DiagnosticReqNAV_b5 = 0x87;
        pc_tx_phys.DiagnosticReqNAV_b6 = 0x01;
        pc_tx_phys.DiagnosticReqNAV_b7 = 0x00;
        output(pc_tx_phys);
        rev_flag = TestWaitForMessage(NAV_MSC_FrI00,50);
        if(rev_flag == 1)
        {
            TestStepPass("Test Step","There is a response in time");
        }
        else if(rev_flag == 0)
        {
            TestStepFail("Test Step","Wrong!No response");
        }
        else 
        {
            TestStepFail("Test Step", "Error!"); 
        }
        testWaitForTimeout(5000);
        putvalue(Ev_Restart_Flag,1);
        testWaitForTimeout(20000);
        putvalue(Ev_Restart_Flag,0);
        testWaitForTimeout(10000);
    }
 /*TestStep 7*/   
    TestStep ("Test Step", "Read DTC by status mask(0x0C)");
    pc_tx_phys.DiagnosticReqNAV_b0 = 0x03;
    pc_tx_phys.DiagnosticReqNAV_b1 = 0x19;
    pc_tx_phys.DiagnosticReqNAV_b2 = 0x02;
    pc_tx_phys.DiagnosticReqNAV_b3 = 0x0C;
    pc_tx_phys.DiagnosticReqNAV_b4 = 0x00;
    pc_tx_phys.DiagnosticReqNAV_b5 = 0x00;
    pc_tx_phys.DiagnosticReqNAV_b6 = 0x00;
    pc_tx_phys.DiagnosticReqNAV_b7 = 0x00;
    output(pc_tx_phys);
    rev_flag = TestWaitForMessage(NAV_MSC_FrI00,50);
    if(rev_flag == 1)
    {
        TestStepPass("Test Step","There is a response in time");
    }
    else if(rev_flag == 0)
    {
        TestStepFail("Test Step","Wrong!No response");
    }
    else 
    {
        TestStepFail("Test Step", "Error!"); 
    }
    testWaitForTimeout(1000);
    /*TestStep 8*/
    TestStep ("Test Step", "Make the BCM Miss");
    testWaitForTimeout(10000);
    /*TestStep 9*/
    TestStep ("Test Step", "Clear all DTC information of ECU");
    pc_tx_phys.DiagnosticReqNAV_b0 = 0x04;
    pc_tx_phys.DiagnosticReqNAV_b1 = 0x14;
    pc_tx_phys.DiagnosticReqNAV_b2 = 0xFF;
    pc_tx_phys.DiagnosticReqNAV_b3 = 0xFF;
    pc_tx_phys.DiagnosticReqNAV_b4 = 0xFF;
    pc_tx_phys.DiagnosticReqNAV_b5 = 0x00;
    pc_tx_phys.DiagnosticReqNAV_b6 = 0x00;
    pc_tx_phys.DiagnosticReqNAV_b7 = 0x00;
    output(pc_tx_phys);
    rev_flag = TestWaitForMessage(NAV_MSC_FrI00,50);
    if(rev_flag == 1)
    {
        TestStepPass("Test Step","There is a response in time");
    }
    else if(rev_flag == 0)
    {
        TestStepFail("Test Step","Wrong!No response");
    }
    else 
    {
        TestStepFail("Test Step", "Error!"); 
    }
    testWaitForTimeout(1000);
    /*TestStep 10*/
    TestStep ("Test Step", "Wait at least 1000ms");
    testWaitForTimeout(1000);
    /*TestStep 11*/
    TestStep ("Test Step", "Read DTC by status mask(0x0C)");
    pc_tx_phys.DiagnosticReqNAV_b0 = 0x03;
    pc_tx_phys.DiagnosticReqNAV_b1 = 0x19;
    pc_tx_phys.DiagnosticReqNAV_b2 = 0x02;
    pc_tx_phys.DiagnosticReqNAV_b3 = 0x0C;
    pc_tx_phys.DiagnosticReqNAV_b4 = 0x00;
    pc_tx_phys.DiagnosticReqNAV_b5 = 0x00;
    pc_tx_phys.DiagnosticReqNAV_b6 = 0x00;
    pc_tx_phys.DiagnosticReqNAV_b7 = 0x00;
    output(pc_tx_phys);
    rev_flag = TestWaitForMessage(NAV_MSC_FrI00,50);
    if(rev_flag == 1)
    {
        TestStepPass("Test Step","There is a response in time");
    }
    else if(rev_flag == 0)
    {
        TestStepFail("Test Step","Wrong!No response");
    }
    else 
    {
        TestStepFail("Test Step", "Error!"); 
    }
    testWaitForTimeout(1000);
    /*TestStep 12*/
    TestStep ("Test Step", "Make the BCM Miss OK");
    testWaitForTimeout(10000);
    /*TestStep 13*/
    TestStep ("Test Step", "Clear all DTC information of ECU");
    pc_tx_phys.DiagnosticReqNAV_b0 = 0x04;
    pc_tx_phys.DiagnosticReqNAV_b1 = 0x14;
    pc_tx_phys.DiagnosticReqNAV_b2 = 0xFF;
    pc_tx_phys.DiagnosticReqNAV_b3 = 0xFF;
    pc_tx_phys.DiagnosticReqNAV_b4 = 0xFF;
    pc_tx_phys.DiagnosticReqNAV_b5 = 0x00;
    pc_tx_phys.DiagnosticReqNAV_b6 = 0x00;
    pc_tx_phys.DiagnosticReqNAV_b7 = 0x00;
    output(pc_tx_phys);
    rev_flag = TestWaitForMessage(NAV_MSC_FrI00,50);
    if(rev_flag == 1)
    {
        TestStepPass("Test Step","There is a response in time");
    }
    else if(rev_flag == 0)
    {
        TestStepFail("Test Step","Wrong!No response");
    }
    else 
    {
        TestStepFail("Test Step", "Error!"); 
    }
    testWaitForTimeout(1000);

}


on message NAV_MSC_FrI00
{
	pc_rx_data = this;
  if(pc_rx_data.DiagnosticRespNAV_b0 == 0x10)
  {
    pc_tx_phys.DiagnosticReqNAV_b0 = 0x30;
    pc_tx_phys.DiagnosticReqNAV_b1 = 0x00;
    pc_tx_phys.DiagnosticReqNAV_b2 = 0x00;
    pc_tx_phys.DiagnosticReqNAV_b3 = 0x00;
    pc_tx_phys.DiagnosticReqNAV_b4 = 0x00;
    pc_tx_phys.DiagnosticReqNAV_b5 = 0x00;
    pc_tx_phys.DiagnosticReqNAV_b6 = 0x00;
    pc_tx_phys.DiagnosticReqNAV_b7 = 0x00;
    output(pc_tx_phys);
  }
  
}
