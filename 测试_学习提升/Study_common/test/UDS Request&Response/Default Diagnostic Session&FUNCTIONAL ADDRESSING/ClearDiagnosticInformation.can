variables
{
    message     NAV_MSC_FrI00  pc_rx_data;
    message     DIAG_MSC_FrI00 pc_tx_func;
    message     DIAG_MSC_FrI02 pc_tx_phys;
	byte		Long_Txdata[4096];
	byte		Long_Rxdata[4096];
    const long P2max = 40;
    const long P2smax = 40;
}

void MainTest()
{
    TestModuleTitle ("UDS on CAN Request&Response Test");
    TestModuleDescription (" Default Diagnostic Session, Physical Addressing.SID=ClearDiagnosticInformation");
    TestGroupBegin("CAN Diagnostic Message Test", "Test the ClearDiagnosticInformation service");
    ClearDiagnosticInformation_Test ();
    TestGroupEnd(); 
}

on message NAV_MSC_FrI00
{
     pc_rx_data = this;
}

testcase ClearDiagnosticInformation_Test ()
{
    long rev_flag = 0;
    pc_tx_func.DiagnosticFuncAddrRq_m_b0 = 0x04;
    pc_tx_func.DiagnosticFuncAddrRq_m_b1 = 0x14;
    pc_tx_func.DiagnosticFuncAddrRq_m_b2 = 0xFF;
    pc_tx_func.DiagnosticFuncAddrRq_m_b3 = 0xFF;
    pc_tx_func.DiagnosticFuncAddrRq_m_b4 = 0xFF;
    TestCaseTitle("ClearDiagnosticInformation TEST", "Request and check the response");
    TestCaseDescription("send a request and receive a response,then check the response");
    TestStep ("Test Step", "Send:14 FF FF FF");
    output(pc_tx_func);
    rev_flag = TestWaitForMessage(NAV_MSC_FrI00,P2max);
    if(rev_flag == 1)
    {
        TestStepPass("Test Step","There is a response in time");
    }
    else if(rev_flag == 0)
    {
        TestStepFail("Test Step","Wrong!No response");
    }
    else 
    {
        TestStepFail("Test Step", "Error!"); 
    }
    TestStep ("Test Step", "Check the response");
    if((pc_rx_data.DiagnosticRespNAV_b0 == 0x01)&&(pc_rx_data.DiagnosticRespNAV_b1 == 0x54))
    {
         TestStepPass("Test Step","Response Correct");
    }
    else
    {
        TestStepFail("Test Step","Response Wrong");
    }

}

