/*@@var:*/
variables
{
    message     NAV_MSC_FrI00  pc_rx_data;
    message     DIAG_MSC_FrI00 pc_tx_func;
    message     DIAG_MSC_FrI02 pc_tx_phys;
	byte		Long_Txdata[4096];
	byte		Long_Rxdata[4096];
    const long P2max = 100;
    const long P2smax = 100;
}
/*@@end*/

/*@@mainTest:MainTest():*/
void MainTest()
{
    TestModuleTitle ("UDS on CAN Request&Response Test");
    TestModuleDescription (" Default Diagnostic Session, Physical Addressing.SID=ClearDiagnosticInformation");
    TestGroupBegin("CAN Diagnostic Message Test", "Test the ClearDiagnosticInformation service");
    ClearDiagnosticInformation_Test ();
    TestGroupEnd(); 
}
/*@@end*/

/*@@msg:CAN1._______lh1IP21MCE_NAV_EP1V11::NAV_MSC_FrI00 (0x769):*/
on message NAV_MSC_FrI00
{
     pc_rx_data = this;
}
/*@@end*/

/*@@testcase:ClearDiagnosticInformation_Test():*/
testcase ClearDiagnosticInformation_Test ()
{
    long rev_flag = 0;
    pc_tx_phys.DiagnosticReqNAV_b0 = 0x04;
    pc_tx_phys.DiagnosticReqNAV_b1 = 0x14;
    pc_tx_phys.DiagnosticReqNAV_b2 = 0xFF;
    pc_tx_phys.DiagnosticReqNAV_b3 = 0xFF;
    pc_tx_phys.DiagnosticReqNAV_b4 = 0xFF;
    TestCaseTitle("ClearDiagnosticInformation TEST", "Request and check the response");
    TestCaseDescription("send a request and receive a response,then check the response");
    TestStep ("Test Step", "Send:14 FF FF FF");
    output(pc_tx_phys);
    rev_flag = TestWaitForMessage(NAV_MSC_FrI00,P2max);
    if(rev_flag == 1)
    {
        TestStepPass("Test Step","There is a response in time");
    }
    else if(rev_flag == 0)
    {
        TestStepFail("Test Step","Wrong!No response");
    }
    else 
    {
        TestStepFail("Test Step", "Error!"); 
    }
    TestStep ("Test Step", "Check the response");
    if((pc_rx_data.DiagnosticRespNAV_b0 == 0x01)&&(pc_rx_data.DiagnosticRespNAV_b1 == 0x54))
    {
         TestStepPass("Test Step","Response Correct");
    }
    else
    {
        TestStepFail("Test Step","Response Wrong");
    }

}
/*@@end*/

